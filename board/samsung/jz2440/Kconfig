## board/samsung/jz2440/Kconfig
```kconfig
if TARGET_JZ2440

config SYS_CONFIG_NAME
	default "jz2440"

config SYS_BOARD
	default "jz2440"

config SYS_VENDOR
	default "samsung"

config SYS_CPU
	default "arm920t"

config SYS_SOC
	default "s3c24x0"

config S3C24X0
	bool
	default "y"

config S3C2440
	bool
	default "y"

config JZ2440
	bool
	default "y"

endif
```
